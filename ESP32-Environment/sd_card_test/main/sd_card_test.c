#include <stdio.h>
#include <string.h>
#include <stdbool.h>
#include <errno.h>
#include "esp_vfs_fat.h"
#include "sdmmc_cmd.h"
#include "driver/spi_common.h"
#include "esp_log.h"
#include "esp_chip_info.h"
#include "esp_idf_version.h"

static const char *TAG = "sd_status";

#define PIN_MOSI 23
#define PIN_MISO 19
#define PIN_SCK  18
#define PIN_CS   5

// This is the file you'll open on your laptop after pulling the card out.
#define STATUS_PATH "/sdcard/sd_card_status.txt"
#define TEST_PATH   "/sdcard/sd_card_status_testfile.tmp"
#define TEST_STRING "SD_CARD_INTEGRITY_CHECK_0123456789"

void app_main(void)
{
    static char report[2048];   // static, not stack-local -- app_main's task stack is too small for this
    int len = 0;
    bool module_ok = false;
    bool card_ok = false;
    bool integrity_ok = false;
    int boot_count = 1;

    // ---- [1] ESP32 self-check ----
    // If this code is running at all, the chip itself is alive; we just report identity.
    esp_chip_info_t chip;
    esp_chip_info(&chip);
    len += snprintf(report + len, sizeof(report) - len,
        "=== ESP32 + SD CARD STATUS REPORT ===\r\n\r\n"
        "[1] ESP32\r\n"
        "  Model: %s, rev v%d.%d, %d core(s)\r\n"
        "  Features: %s%s%s\r\n"
        "  IDF version: %s\r\n"
        "  Status: OK (this report was generated BY this chip, so it's alive and running)\r\n\r\n",
        (chip.model == CHIP_ESP32) ? "ESP32" : "other/unknown",
        chip.revision / 100, chip.revision % 100, chip.cores,
        (chip.features & CHIP_FEATURE_WIFI_BGN) ? "WiFi " : "",
        (chip.features & CHIP_FEATURE_BT) ? "BT " : "",
        (chip.features & CHIP_FEATURE_BLE) ? "BLE" : "",
        esp_get_idf_version());

    // ---- [2] SD reader module + [3] SD card: bring up SPI and mount ----
    spi_bus_config_t bus_cfg = {
        .mosi_io_num = PIN_MOSI,
        .miso_io_num = PIN_MISO,
        .sclk_io_num = PIN_SCK,
        .quadwp_io_num = -1,
        .quadhd_io_num = -1,
        .max_transfer_sz = 4000,
    };
    esp_err_t bus_ret = spi_bus_initialize(SPI3_HOST, &bus_cfg, SDSPI_DEFAULT_DMA);

    sdmmc_host_t host = SDSPI_HOST_DEFAULT();
    host.slot = SPI3_HOST;
    host.max_freq_khz = 4000;   // jumper wires can't reliably carry the ~20MHz default

    sdspi_device_config_t slot_cfg = SDSPI_DEVICE_CONFIG_DEFAULT();
    slot_cfg.gpio_cs = PIN_CS;
    slot_cfg.host_id = SPI3_HOST;

    esp_vfs_fat_sdmmc_mount_config_t mount_cfg = {
        .format_if_mount_failed = false,
        .max_files = 5,
        .allocation_unit_size = 16 * 1024,
    };

    sdmmc_card_t *card = NULL;
    esp_err_t mount_ret = ESP_FAIL;

    if (bus_ret == ESP_OK) {
        mount_ret = esp_vfs_fat_sdspi_mount("/sdcard", &host, &slot_cfg, &mount_cfg, &card);
    }

    if (bus_ret != ESP_OK || mount_ret != ESP_OK) {
        // Can't write a status file to a card that won't mount — chicken-and-egg.
        // This case can ONLY be reported on the serial monitor, not on the card itself.
        ESP_LOGE(TAG, "=== SD CARD STATUS: FAIL ===");
        ESP_LOGE(TAG, "[1] ESP32: OK (running)");
        ESP_LOGE(TAG, "[2] SD reader module: %s", bus_ret == ESP_OK ? "SPI bus OK, but card did not mount" : "SPI bus init FAILED");
        ESP_LOGE(TAG, "[3] SD card: NOT DETECTED (mount error 0x%x)", mount_ret);
        ESP_LOGE(TAG, "Cannot write sd_card_status.txt onto a card that won't mount.");
        ESP_LOGE(TAG, "Check: wiring (CS=%d/MOSI=%d/MISO=%d/SCK=%d), VCC on 5V (not 3.3V), card fully seated.",
                 PIN_CS, PIN_MOSI, PIN_MISO, PIN_SCK);
        return;
    }

    module_ok = true;   // SPI bus + mount both succeeded -> reader module is bridging commands fine
    card_ok = true;     // card responded to the full SD init sequence

    len += snprintf(report + len, sizeof(report) - len,
        "[2] SD CARD READER MODULE (SPI)\r\n"
        "  SPI bus init: OK\r\n"
        "  Card mount:   OK (module is correctly bridging ESP32 <-> card over SPI)\r\n"
        "  Status: OK\r\n\r\n"
        "[3] SD CARD\r\n"
        "  Name: %s\r\n"
        "  Type: %s\r\n"
        "  Speed: %d kHz (limit %d kHz)\r\n"
        "  Size: %llu MB\r\n"
        "  Status: OK\r\n\r\n",
        card->cid.name,
        (card->ocr & (1 << 30)) ? "SDHC/SDXC" : "SDSC",
        card->real_freq_khz, card->max_freq_khz,
        (unsigned long long)((uint64_t)card->csd.capacity) * card->csd.sector_size / (1024 * 1024));

    // ---- [4] Read/write integrity check — catches silent corruption, not just total failure ----
    errno = 0;
    FILE *f = fopen(TEST_PATH, "w");
    if (f) {
        int written = fprintf(f, "%s", TEST_STRING);
        int close_ret = fclose(f);
        ESP_LOGI(TAG, "TEST_PATH write: fprintf returned %d, fclose returned %d (errno=%d %s)",
                 written, close_ret, errno, strerror(errno));

        errno = 0;
        f = fopen(TEST_PATH, "r");
        if (f) {
            char readback[64] = {0};
            fgets(readback, sizeof(readback), f);
            fclose(f);
            integrity_ok = (strcmp(readback, TEST_STRING) == 0);
            ESP_LOGI(TAG, "TEST_PATH read back: \"%s\" (expected \"%s\")", readback, TEST_STRING);
        } else {
            ESP_LOGE(TAG, "TEST_PATH reopen-for-read FAILED: errno=%d (%s)", errno, strerror(errno));
        }
        remove(TEST_PATH);
    } else {
        ESP_LOGE(TAG, "TEST_PATH open-for-write FAILED: errno=%d (%s)", errno, strerror(errno));
    }

    // ---- Persisted boot counter: read the OLD status file (if any) before overwriting it ----
    // If this number goes up every power-cycle, writes are genuinely reaching the card.
    f = fopen(STATUS_PATH, "r");
    if (f) {
        char old_line[64];
        while (fgets(old_line, sizeof(old_line), f)) {
            int parsed;
            if (sscanf(old_line, "Boot count: %d", &parsed) == 1) {
                boot_count = parsed + 1;
                break;
            }
        }
        fclose(f);
    }

    bool overall_ok = module_ok && card_ok && integrity_ok;

    len += snprintf(report + len, sizeof(report) - len,
        "[4] READ/WRITE INTEGRITY CHECK\r\n"
        "  Wrote a known string, read it back, compared byte-for-byte: %s\r\n\r\n"
        "Boot count: %d\r\n"
        "  (this should go UP by 1 every time you power this board on with the\r\n"
        "  card inserted — if it's frozen across power cycles, writes aren't\r\n"
        "  really reaching the card even though the code isn't crashing)\r\n\r\n"
        "=== OVERALL: %s ===\r\n",
        integrity_ok ? "MATCH" : "MISMATCH -- card is corrupting data!",
        boot_count,
        overall_ok ? "PASS -- ESP32, reader module, and SD card are all working correctly"
                   : "FAIL -- see the MISMATCH line above");

    errno = 0;
    f = fopen(STATUS_PATH, "w");
    if (f) {
        fprintf(f, "%s", report);
        fclose(f);
        ESP_LOGI(TAG, "Wrote %s -- remove the card, plug it into your laptop, open it in any text editor.", STATUS_PATH);
    } else {
        ESP_LOGE(TAG, "Could not write the status file itself: errno=%d (%s)", errno, strerror(errno));
    }

    puts(report);   // also show the full report on the serial monitor right now
}
